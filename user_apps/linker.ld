ENTRY(_start)
OUTPUT_FORMAT(elf32-i386)

SECTIONS {
    /* Standard ELF load address */
    . = 0x08048000;

    .text : {
        *(.text)
        *(.text.*)
    }

    .rodata : {
        *(.rodata)
        *(.rodata.*)
    }

    .data : {
        *(.data)
        *(.data.*)
    }

    .bss : {
        *(.bss)
        *(.bss.*)
        *(COMMON)
    }
}
