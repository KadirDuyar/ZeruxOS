/* =============================================================================
 * ZeruX OS — Kernel Linker Script
 * File: kernel/linker.ld
 * =============================================================================
 *
 * WHAT IS A LINKER SCRIPT?
 * ────────────────────────
 * When GCC compiles your .c files it produces .o (object) files — relocatable
 * binary blobs with unresolved symbol references.  The linker (ld) reads all
 * .o files and combines them into one final binary.
 *
 * The linker script tells ld:
 *   • At what address should the output start?         (. = 0x100000)
 *   • In what order should the input sections appear?  (.text first, etc.)
 *   • What should be included / excluded?
 *
 * WHY 0x100000?
 * ─────────────
 * The bootloader switches to protected mode and executes:
 *
 *     jmp 0x08:0x100000
 *
 * This sets CS to our flat 4 GB code segment and EIP to 0x100000.
 * The CPU then fetches and executes whatever bytes sit at physical 0x100000.
 *
 * The linker script's `. = 0x100000` tells ld to assign all symbols as if
 * code starts at 0x100000 — so virtual addresses match physical addresses
 * in our flat identity-mapped memory model.
 *
 * WHY .entry FIRST?
 * ─────────────────
 * The bootloader jumps blindly to 0x100000 — it doesn't know the name of
 * our entry function, it just jumps to the raw address.
 *
 * By default the linker places .text sections in the order it encounters
 * them, which may put helper functions BEFORE kernel_main.  That would make
 * the CPU execute those helpers as if they were kernel_main — instant crash.
 *
 * The fix: mark kernel_main with __attribute__((section(".entry"))) and list
 * .entry before .text in this script.  Now kernel_main is guaranteed to be
 * the first bytes of the kernel binary, right at 0x100000.
 *
 * OUTPUT FORMAT
 * ─────────────
 * We output a raw flat binary ("binary" format).  No ELF headers, no PE
 * headers — just machine code bytes, exactly like the bootloader.
 *
 * The dd command in the Makefile appends this raw binary directly after the
 * 512-byte bootloader on the disk image.  The bootloader reads it at sector 2
 * and copies it to 0x100000.
 * =============================================================================
 */

/*
 * ENTRY — tells the linker (and debuggers) which symbol is the entry point.
 * This does NOT affect where bytes land in the binary; the SECTIONS block
 * below controls that.  It's mainly informational for gdb / objdump.
 */
ENTRY(kernel_main)

SECTIONS {

    /*
     * Set the location counter to 0x100000.
     * All subsequent symbol addresses will be relative to this base.
     * Because we use an identity-mapped flat model (base=0), virtual = physical.
     */
    . = 0x100000;
    _kernel_start = .;

    /*
     * ── .text — Executable code ──────────────────────────────────────────
     *
     * Layout:
     *   [offset 0x000]  .entry  ← kernel_main() — must be first!
     *   [offset N]      .text   ← all other compiled functions
     *   [offset M]      .text.* ← any sub-sections (e.g., from -ffunction-sections)
     *
     * KEEP() — prevents the section from being discarded if garbage collection
     * is enabled (-Wl,--gc-sections).  kernel_main has no callers visible to
     * the linker (the bootloader calls it by raw address), so without KEEP it
     * might be wrongly eliminated.
     */
    .text : {
        KEEP(*(.entry))     /* kernel_main — first byte at exactly 0x100000 */
        *(.text)            /* All other .text sections from all .o files     */
        *(.text.*)          /* Sub-sections (e.g., from -ffunction-sections)  */
    }

    /*
     * ── .rodata — Read-only data ─────────────────────────────────────────
     *
     * String literals (e.g., "Hello, World!"), const global arrays, jump
     * tables generated by the compiler.  Placed after .text.
     */
    .rodata : {
        *(.rodata)
        *(.rodata.*)
    }

    /*
     * ── .data — Initialized data ─────────────────────────────────────────
     *
     * Global / static variables that have an explicit initial value.
     * Example:  int x = 42;   ← goes here (the 42 is stored in the binary)
     *
     * In our kernel the VGA cursor variables (vga_row, vga_col, etc.) are
     * static and initialized to 0 — those actually go into .bss, not .data,
     * because zero-initialized data doesn't need storage in the binary.
     */
    .data : {
        *(.data)
        *(.data.*)
    }

    /*
     * ── .bss — Zero-initialized data ─────────────────────────────────────
     *
     * Global / static variables with no initializer OR initialized to 0.
     * The linker records their total SIZE here but writes NO bytes to the
     * output binary (they'll be zero because they live in BSS).
     *
     * A production OS would zero this region at startup (before entering C).
     * For ZeruX, our uninitialized variables happen to be VGA state vars that
     * vga_init() sets explicitly before use — so skipping BSS zeroing is safe.
     *
     * COMMON — handles "tentative definitions" (uninitialized global variables
     * declared without `extern` in older C style).
     */
    .bss : {
        __bss_start = .;
        *(COMMON)
        *(.bss)
        *(.bss.*)
        __bss_end = .;
    }

    _kernel_end = .;

    /*
     * Discard debugging sections, comments, and other metadata.
     * We want a lean raw binary — no debug info bloats the kernel image.
     */
    /DISCARD/ : {
        *(.comment)
        *(.note*)
        *(.eh_frame*)
        *(.debug*)
    }
}
